// SPDX-License-Identifier: (GPL-2.0-or-later OR BSD-2-Clause)
/*
 * Copyright (C) 2026 Bootlin
 */

/dts-v1/;

/ {
	base_node: base-node {
		compatible = "abc,base";
		exist_bool;
		exist_int = <123>;
		exist_string = "abcdef";
		/export/ base: &base_node;

		sub-node {
			sub_exist_bool;
			sub_exist_int = <456>;
			sub_exist_string = "ghi";
		};
	};
};
